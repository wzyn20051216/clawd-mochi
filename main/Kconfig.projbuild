## main/Kconfig.projbuild
```kconfig
menu "Clawd Mochi"

    choice MOCHI_LCD_DRIVER
        prompt "LCD driver"
        default MOCHI_LCD_DRIVER_ST7735

        config MOCHI_LCD_DRIVER_ST7735
            bool "ST7735 1.8 inch 128x160"

        config MOCHI_LCD_DRIVER_ST7789
            bool "ST7789 1.54 inch 240x240"
    endchoice

    config MOCHI_PIN_LCD_MOSI
        int "LCD MOSI GPIO"
        default 10

    config MOCHI_PIN_LCD_SCLK
        int "LCD SCLK GPIO"
        default 8

    config MOCHI_PIN_LCD_CS
        int "LCD CS GPIO"
        default 4

    config MOCHI_PIN_LCD_DC
        int "LCD DC GPIO"
        default 1

    config MOCHI_PIN_LCD_RST
        int "LCD reset GPIO"
        default 2

    config MOCHI_PIN_LCD_BL
        int "LCD backlight GPIO"
        default 3

    config MOCHI_LCD_BACKLIGHT_ACTIVE_HIGH
        bool "LCD backlight is active high"
        default y

    config MOCHI_LCD_SPI_CLOCK_HZ
        int "LCD SPI clock Hz"
        default 27000000 if MOCHI_LCD_DRIVER_ST7735
        default 40000000 if MOCHI_LCD_DRIVER_ST7789

    config MOCHI_LCD_MADCTL
        hex "LCD MADCTL rotation value"
        default 0xC0 if MOCHI_LCD_DRIVER_ST7735
        default 0x60 if MOCHI_LCD_DRIVER_ST7789

    config MOCHI_LCD_X_OFFSET
        int "LCD X offset"
        default 0

    config MOCHI_LCD_Y_OFFSET
        int "LCD Y offset"
        default 0

    config MOCHI_WIFI_AP_SSID
        string "WiFi AP SSID"
        default "ClaWD-Mochi"

    config MOCHI_WIFI_AP_PASSWORD
        string "WiFi AP password"
        default "clawd1234"

    config MOCHI_WIFI_STA_SSID
        string "WiFi station SSID"
        default ""

    config MOCHI_WIFI_STA_PASSWORD
        string "WiFi station password"
        default ""

    menu "Voice Module"

        config MOCHI_VOICE_MODULE_ENABLE
            bool "Enable CI1302/Yahboom UART voice module"
            default y

        config MOCHI_VOICE_MODULE_UART_PORT
            int "Voice module UART port"
            depends on MOCHI_VOICE_MODULE_ENABLE
            default 1
            range 1 2
            help
                UART0 is reserved for ESP-IDF logs and flashing. Use UART1 or UART2.

        config MOCHI_VOICE_MODULE_BAUDRATE
            int "Voice module UART baudrate"
            depends on MOCHI_VOICE_MODULE_ENABLE
            default 115200

        config MOCHI_VOICE_MODULE_RX_GPIO
            int "ESP32 RX GPIO connected to voice module TX"
            depends on MOCHI_VOICE_MODULE_ENABLE
            default 18

        config MOCHI_VOICE_MODULE_TX_GPIO
            int "ESP32 TX GPIO connected to voice module RX"
            depends on MOCHI_VOICE_MODULE_ENABLE
            default 21

        config MOCHI_VOICE_MODULE_TASK_STACK
            int "Voice module task stack size"
            depends on MOCHI_VOICE_MODULE_ENABLE
            default 4096

        config MOCHI_VOICE_MODULE_TASK_PRIO
            int "Voice module task priority"
            depends on MOCHI_VOICE_MODULE_ENABLE
            default 5

    endmenu

endmenu
```

## sdkconfig.defaults
```kconfig
CONFIG_IDF_TARGET="esp32s3"
CONFIG_MOCHI_LCD_DRIVER_ST7735=y
CONFIG_MOCHI_LCD_BACKLIGHT_ACTIVE_HIGH=y
CONFIG_ESPTOOLPY_FLASHSIZE_8MB=y
CONFIG_ESPTOOLPY_FLASHSIZE="8MB"
CONFIG_COMPILER_CXX_EXCEPTIONS=n
CONFIG_COMPILER_CXX_RTTI=n
CONFIG_FREERTOS_HZ=1000
CONFIG_ESP_MAIN_TASK_STACK_SIZE=8192
CONFIG_HTTPD_MAX_REQ_HDR_LEN=1024
CONFIG_HTTPD_MAX_URI_LEN=4096
CONFIG_LWIP_LOCAL_HOSTNAME="clawd-mochi"
CONFIG_PARTITION_TABLE_SINGLE_APP=n
CONFIG_PARTITION_TABLE_SINGLE_APP_LARGE=y
CONFIG_PARTITION_TABLE_FILENAME="partitions_singleapp_large.csv"
CONFIG_BT_ENABLED=y
CONFIG_BT_BLUEDROID_ENABLED=n
CONFIG_BT_NIMBLE_ENABLED=y
CONFIG_BT_NIMBLE_ROLE_CENTRAL=n
CONFIG_BT_NIMBLE_ROLE_PERIPHERAL=y
CONFIG_BT_NIMBLE_ROLE_BROADCASTER=y
CONFIG_BT_NIMBLE_ROLE_OBSERVER=n
CONFIG_BT_NIMBLE_GATT_CLIENT=n
CONFIG_BT_NIMBLE_GATT_SERVER=y
CONFIG_BT_NIMBLE_SECURITY_ENABLE=n
CONFIG_BT_NIMBLE_MAX_CONNECTIONS=1
CONFIG_BT_NIMBLE_MAX_BONDS=1
CONFIG_BT_NIMBLE_MAX_CCCDS=1
CONFIG_BT_NIMBLE_ATT_PREFERRED_MTU=64
CONFIG_BT_NIMBLE_ATT_MAX_PREP_ENTRIES=4
CONFIG_BT_NIMBLE_GATT_MAX_PROCS=3
CONFIG_BT_NIMBLE_ENABLE_CONN_REATTEMPT=n
CONFIG_BT_NIMBLE_MSYS_1_BLOCK_COUNT=8
CONFIG_BT_NIMBLE_MSYS_2_BLOCK_COUNT=8
CONFIG_BT_NIMBLE_TRANSPORT_ACL_FROM_LL_COUNT=8
CONFIG_BT_NIMBLE_TRANSPORT_EVT_COUNT=15
CONFIG_BT_NIMBLE_50_FEATURE_SUPPORT=n
CONFIG_BT_NIMBLE_PROX_SERVICE=n
CONFIG_BT_NIMBLE_ANS_SERVICE=n
CONFIG_BT_NIMBLE_CTS_SERVICE=n
CONFIG_BT_NIMBLE_HTP_SERVICE=n
CONFIG_BT_NIMBLE_IPSS_SERVICE=n
CONFIG_BT_NIMBLE_TPS_SERVICE=n
CONFIG_BT_NIMBLE_IAS_SERVICE=n
CONFIG_BT_NIMBLE_LLS_SERVICE=n
CONFIG_BT_NIMBLE_SPS_SERVICE=n
CONFIG_BT_NIMBLE_HR_SERVICE=n
CONFIG_BT_NIMBLE_BAS_SERVICE=n
CONFIG_BT_NIMBLE_DIS_SERVICE=n
```
